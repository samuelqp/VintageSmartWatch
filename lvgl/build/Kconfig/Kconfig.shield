## lvgl/build/Kconfig/Kconfig.shield
```kconfig
osource "c:/nordic/displaytests/lvgl/boards/shields/*/Kconfig.shield"
osource "C:/ncs/v2.4.1/nrf/boards/shields/*/Kconfig.shield"
```

## lvgl/build/Kconfig/Kconfig.shield.defconfig
```kconfig
osource "c:/nordic/displaytests/lvgl/boards/shields/*/Kconfig.defconfig"
osource "C:/ncs/v2.4.1/nrf/boards/shields/*/Kconfig.defconfig"
```

## lvgl/build_4/Kconfig/Kconfig.shield
```kconfig
osource "/home/samuel/local-projects/1030.lvgl/lvgl/boards/shields/*/Kconfig.shield"
osource "/home/samuel/ncs/v2.6.0/nrf/boards/shields/*/Kconfig.shield"
```

## lvgl/build_5/Kconfig/Kconfig.sysbuild.modules
```kconfig
menu "nrf (/home/samuel/ncs/v2.6.0/nrf)"
osource "/home/samuel/ncs/v2.6.0/nrf/sysbuild/Kconfig.sysbuild"
config ZEPHYR_NRF_MODULE
	bool
	default y
endmenu
```
